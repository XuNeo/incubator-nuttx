## arch/arm/src/t113/Kconfig
```kconfig
#
# For a description of the syntax of this configuration file,
# see the file kconfig-language.txt in the NuttX tools repository.
#

if ARCH_CHIP_T113

comment "T113-S3 Configuration Options"

choice
	prompt "Allwinner T113 Chip Selection"
	default ARCH_CHIP_T113S3

config ARCH_CHIP_T113S3
	bool "T113-S3"
	select ARCH_HAVE_MULTICPU
	---help---
		Allwinner T113-S3 (also known as R528). Dual ARM Cortex-A7,
		GIC-400 (GICv2), DDR3, SPI-NAND boot.

endchoice # Allwinner T113 Chip Selection

menu "Allwinner T113 Peripheral Support"

config T113_UART0
	bool "UART 0"
	default n
	select UART0_SERIALDRIVER
	select ARCH_HAVE_SERIAL_TERMIOS

config T113_UART1
	bool "UART 1"
	default n
	select UART1_SERIALDRIVER
	select ARCH_HAVE_SERIAL_TERMIOS

config T113_UART2
	bool "UART 2"
	default n
	select UART2_SERIALDRIVER
	select ARCH_HAVE_SERIAL_TERMIOS

config T113_UART3
	bool "UART 3"
	default n
	select UART3_SERIALDRIVER
	select ARCH_HAVE_SERIAL_TERMIOS

config T113_DMA
	bool "DMA Controller"
	default n
	select ARCH_DMA
	---help---
		Enable T113 DMAC driver (16 channels).
		Required by T113_SPI_DMA.

config T113_SPI0
	bool "SPI 0"
	default n
	select SPI
	select ARCH_HAVE_SPI_CSNCONTROL

config T113_SPI1
	bool "SPI 1"
	default n
	select SPI
	select ARCH_HAVE_SPI_CSNCONTROL

config T113_SPI0_DMA
	bool "SPI 0 DMA support"
	default y
	depends on T113_SPI0 && T113_DMA

config T113_SPI1_DMA
	bool "SPI 1 DMA support"
	default y
	depends on T113_SPI1 && T113_DMA

config T113_TWI0
	bool "I2C 0 (TWI0)"
	default n
	select I2C

config T113_TWI1
	bool "I2C 1 (TWI1)"
	default n
	select I2C

config T113_TWI2
	bool "I2C 2 (TWI2)"
	default n
	select I2C

config T113_TWI3
	bool "I2C 3 (TWI3)"
	default n
	select I2C

config T113_USBDEV
	bool "USB Device Controller (MUSB OTG)"
	default n
	select USBDEV
	---help---
		Enable T113 MUSB OTG USB device controller driver.
		Supports CDC-ACM and ADB over USB in device mode.

config T113_WDT
	bool "Watchdog Timer"
	default n
	select WATCHDOG
	select ARCH_HAVE_RESET
	---help---
		Enable T113 watchdog timer driver.

config T113_GPIO
	bool "GPIO (PIO Controller)"
	default n
	---help---
		Enable T113 GPIO driver for banks B-G.

config T113_RTC
	bool "RTC (Real-Time Clock)"
	default n
	select RTC
	select RTC_DRIVER
	select RTC_DATETIME
	---help---
		Enable T113 RTC driver.  Uses the on-chip LOSC-based
		RTC with YMD/HMS registers.

config T113_PWM
	bool "PWM Controller"
	default n
	select PWM
	---help---
		Enable T113 PWM driver.  8 channels, 24MHz HOSC clock source.

config T113_GPADC
	bool "GPADC (General Purpose ADC)"
	default n
	select ADC
	---help---
		Enable T113 12-bit GPADC driver.  Up to 4 channels.

endmenu # Allwinner T113 Peripheral Support

config T113_DDR_MAPSIZE
	int "Installed DDR size (bytes)"
	default 134217728
	---help---
		Physical DDR size installed on board.
		128 MB = 134217728
		256 MB = 268435456

config T113_BOOT0
	bool "Include boot0 (DDR init + BROM header) for standalone NAND boot"
	default n
	---help---
		Enable to produce a self-bootable binary for NAND/SPI-NOR.
		boot0 code is linked at the start of .text and handles clock
		and DDR initialization before jumping to NuttX __start.
		Requires -fno-lto -O3 -fno-stack-protector for t113_load.c.
		Disable when using xfel to debug (DDR pre-initialized by
		"xfel ddr t113-s3").

endif # ARCH_CHIP_T113
```

## boards/arm/t113/t113-evb/configs/nsh/defconfig
```kconfig
CONFIG_ARCH="arm"
CONFIG_ARCH_BOARD="t113-evb"
CONFIG_ARCH_BOARD_T113_EVB=y
CONFIG_ARCH_CHIP="t113"
CONFIG_ARCH_CHIP_T113=y
CONFIG_ARCH_CHIP_T113S3=y
CONFIG_ARCH_INTERRUPTSTACK=2048
CONFIG_ARCH_LOWVECTORS=y
CONFIG_ARCH_STACKDUMP=y
CONFIG_DEBUG_ASSERTIONS=y
CONFIG_DEBUG_ASSERTIONS_EXPRESSION=y
CONFIG_DEBUG_FEATURES=y
CONFIG_DEBUG_ERROR=y
CONFIG_DEBUG_WARN=y
CONFIG_BOARD_LOOPSPERMSEC=49341
CONFIG_BOOT_RUNFROMSDRAM=y
CONFIG_BUILTIN=y
CONFIG_DEFAULT_TASK_STACKSIZE=8192
CONFIG_IDLETHREAD_STACKSIZE=8192
CONFIG_PTHREAD_STACK_DEFAULT=4096
CONFIG_INIT_ENTRYPOINT="nsh_main"
CONFIG_NSH_BUILTIN_APPS=y
CONFIG_NSH_READLINE=y
CONFIG_RAM_SIZE=134217728
CONFIG_RAM_START=0x40000000
CONFIG_RAM_VSTART=0x40000000
CONFIG_RAW_BINARY=y
CONFIG_SCHED_WAITPID=y
CONFIG_SYSTEM_NSH=y
# CONFIG_T113_BOOT0 is not set
CONFIG_T113_DDR_MAPSIZE=134217728
CONFIG_T113_UART0=y
CONFIG_UART0_SERIAL_CONSOLE=y
CONFIG_T113_DMA=y
CONFIG_T113_SPI0=y
CONFIG_T113_SPI0_DMA=y
CONFIG_SPI=y
CONFIG_SPI_EXCHANGE=y
CONFIG_SPI_DRIVER=y
CONFIG_T113_TWI0=y
CONFIG_I2C=y
CONFIG_I2C_DRIVER=y
CONFIG_MTD=y
CONFIG_MTD_MX35=y
CONFIG_MX35_SPIMODE=0
CONFIG_MX35_SPIFREQUENCY=40000000
CONFIG_MTD_PARTITION=y
CONFIG_MTD_BYTE_WRITE=y
CONFIG_FS_LITTLEFS=y
CONFIG_SYSTEM_I2CTOOL=y
CONFIG_BOARD_LATE_INITIALIZE=y
CONFIG_BOARDCTL=y
CONFIG_EXAMPLES_HELLO=y
CONFIG_EXAMPLES_T113_TEST=y
CONFIG_BCH=y
CONFIG_SYSTEM_NSH_STACKSIZE=8192
# CONFIG_ARCH_TRUSTZONE_SECURE is not set
```

## boards/arm/t113/t113-evb/configs/usbnsh/defconfig
```kconfig
CONFIG_ARCH="arm"
CONFIG_ARCH_BOARD="t113-evb"
CONFIG_ARCH_BOARD_T113_EVB=y
CONFIG_ARCH_CHIP="t113"
CONFIG_ARCH_CHIP_T113=y
CONFIG_ARCH_CHIP_T113S3=y
CONFIG_ARCH_INTERRUPTSTACK=2048
CONFIG_ARCH_LOWVECTORS=y
CONFIG_ARCH_STACKDUMP=y
CONFIG_DEBUG_ASSERTIONS=y
CONFIG_DEBUG_ASSERTIONS_EXPRESSION=y
CONFIG_DEBUG_FEATURES=y
CONFIG_DEBUG_ERROR=y
CONFIG_DEBUG_WARN=y
CONFIG_DEBUG_SYMBOLS=y
CONFIG_STACK_COLORATION=y
CONFIG_SCHED_BACKTRACE=y
CONFIG_BOARD_LOOPSPERMSEC=49341
CONFIG_BOOT_RUNFROMSDRAM=y
CONFIG_BUILTIN=y
CONFIG_SMP=y
CONFIG_SMP_NCPUS=2
CONFIG_DEFAULT_TASK_STACKSIZE=8192
CONFIG_IDLETHREAD_STACKSIZE=8192
CONFIG_PTHREAD_STACK_DEFAULT=4096
CONFIG_INIT_ENTRYPOINT="nsh_main"
CONFIG_NSH_BUILTIN_APPS=y
CONFIG_NSH_READLINE=y
CONFIG_RAM_SIZE=134217728
CONFIG_RAM_START=0x40000000
CONFIG_RAM_VSTART=0x40000000
CONFIG_RAW_BINARY=y
CONFIG_SCHED_WAITPID=y
CONFIG_SYSTEM_NSH=y
# CONFIG_T113_BOOT0 is not set
CONFIG_T113_DDR_MAPSIZE=134217728
CONFIG_T113_UART0=y
# CONFIG_UART0_SERIAL_CONSOLE is not set
CONFIG_BOARD_LATE_INITIALIZE=y
CONFIG_BOARDCTL=y
CONFIG_BOARDCTL_RESET=y
CONFIG_BOARDCTL_RESET_CAUSE=y
CONFIG_BOARDCTL_USBDEVCTRL=y
CONFIG_T113_WDT=y
CONFIG_WATCHDOG_AUTOMONITOR=y
CONFIG_WATCHDOG_AUTOMONITOR_BY_WORKER=y
CONFIG_WATCHDOG_AUTOMONITOR_TIMEOUT=30
CONFIG_SCHED_LPWORK=y
CONFIG_T113_GPIO=y
CONFIG_T113_RTC=y
CONFIG_T113_PWM=y
CONFIG_T113_GPADC=y
CONFIG_SCHED_TICKLESS=y
CONFIG_SCHED_TICKLESS_ALARM=y
CONFIG_T113_USBDEV=y
CONFIG_USBDEV=y
CONFIG_USBDEV_DUALSPEED=y
CONFIG_CDCACM=y
CONFIG_CDCACM_CONSOLE=y
CONFIG_EXAMPLES_HELLO=y
CONFIG_BCH=y
CONFIG_SYSTEM_NSH_STACKSIZE=8192
# CONFIG_ARCH_TRUSTZONE_SECURE is not set
```
